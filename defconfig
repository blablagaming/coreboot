## defconfig
```kconfig
CONFIG_VENDOR_DELL=y
CONFIG_MAINBOARD_PART_NUMBER="OptiPlex 7010"
CONFIG_BOARD_DELL_OPTIPLEX_9010=y
CONFIG_INCLUDE_SMSC_SCH5545_EC_FW=y
CONFIG_SMSC_SCH5545_EC_FW_FILE="/home/joeys/fgmod/sch5545_ecfw.bin"
CONFIG_EDK2_BOOT_MANAGER_ESCAPE=y
CONFIG_EDK2_FOLLOW_BGRT_SPEC=y
CONFIG_MAINBOARD_SERIAL_NUMBER="6942069"
CONFIG_PAYLOAD_EDK2=y
CONFIG_SEABIOS_SECONDARY_PAYLOAD=y
CONFIG_FRAMEBUFFER_SPLASH_TEXT=y
```
